## main/Kconfig.projbuild
```kconfig
menu "SIOT IMS NeoPixel"

    config SIOT_WIFI_SSID
        string "Wi-Fi SSID"
        default ""
        help
            Generated from .env (WIFI_SSID) by tools/env_to_sdkconfig.py.

    config SIOT_WIFI_PASSWORD
        string "Wi-Fi password"
        default ""
        help
            Generated from .env (WIFI_PASSWORD). Compiled into the flash image.

    config SIOT_IMS_URL
        string "IMS poll URL (optional until the IMS poller exists)"
        default ""
        help
            Generated from .env (IMS_URL).

    config SIOT_IMS_TOKEN
        string "IMS auth token"
        default ""
        help
            Generated from .env (IMS_TOKEN). Compiled into the flash image.

    config SIOT_IMS_MOCK_CA
        bool "Trust the mock IMS CA (bench builds only)"
        default n
        help
            Generated from .env (IMS_MOCK_CA=1). Adds the mock server's CA to the trusted
            set so the board can talk to tools/mock_ims.py. A production build leaves this
            off and trusts only the certificate bundle, with no insecure fallback.

    config SIOT_DEVICE_ID
        string "Device ID presented to IMS"
        default ""

    config SIOT_LED_GPIO
        int "NeoPixel data GPIO"
        range 0 33
        default 18

    config SIOT_LED_COUNT
        int "NeoPixel count (one per drawer)"
        range 1 30
        default 5

    config SIOT_CABINET
        string "Cabinet letter (A or B)"
        default "A"
        help
            Generated from .env (CABINET).

    config SIOT_DRAWER_MAP
        string "Physical drawer of each pixel, in pixel order"
        default "A1,A2,A3,A4,A5"
        help
            Generated from .env (DRAWER_MAP). Codes start with the cabinet letter.

    config SIOT_POLL_INTERVAL_MS
        int "IMS poll interval (ms)"
        range 1000 3600000
        default 5000

    config SIOT_GLOW_MS
        int "Glow duration (ms)"
        range 100 600000
        default 5000

    config SIOT_GLOW_BRIGHTNESS_PCT
        int "Glow brightness (percent of full)"
        range 1 100
        default 25

    config SIOT_GLOW_RGB
        hex "Glow colour (0xRRGGBB)"
        range 0x000000 0xFFFFFF
        default 0xFFB46E

    config SIOT_WEB_TOKEN
        string "Web test page access token (empty = no auth)"
        default ""
        help
            Generated from .env (WEB_TOKEN). If set, POSTs to the test API must send it in
            the X-Auth-Token header.

    config SIOT_LED_BOOT_TEST
        bool "Wiring test: chase drawers 1..N at boot"
        default y
        help
            Lights drawers one after another at startup to verify wiring. Disable once
            the IMS poller drives the LEDs.

endmenu
```

## sdkconfig.defaults
```kconfig
CONFIG_IDF_TARGET="esp32"
CONFIG_ESP_TASK_WDT_EN=y
CONFIG_ESP_TASK_WDT_INIT=y
CONFIG_ESPTOOLPY_FLASHSIZE_4MB=y
CONFIG_PARTITION_TABLE_CUSTOM=y
CONFIG_PARTITION_TABLE_CUSTOM_FILENAME="partitions.csv"
```
